; vim:noet:sw=8:ts=8:ai:syn=pic

; Buffer descriptor table addresses (linear and banked)
; Valid only for PPB mode 01 (ping-pong buffer on EP0 OUT only)

BDT_START		equ	0x2000
BDT_ENTRY_SIZE		equ	4
NUM_BDT_ENTRIES		equ	17
BDT_LEN			equ	BDT_ENTRY_SIZE*NUM_BDT_ENTRIES

EP0OUT_EVEN		equ	BDT_START+(BDT_ENTRY_SIZE*0)
EP0OUT_EVEN_STAT	equ	EP0OUT_EVEN+0
EP0OUT_EVEN_CNT		equ	EP0OUT_EVEN+1
EP0OUT_EVEN_ADRL	equ	EP0OUT_EVEN+2
EP0OUT_EVEN_ADRH	equ	EP0OUT_EVEN+3

EP0OUT_ODD		equ	BDT_START+(BDT_ENTRY_SIZE*1)
EP0OUT_ODD_STAT		equ	EP0OUT_ODD+0
EP0OUT_ODD_CNT		equ	EP0OUT_ODD+1
EP0OUT_ODD_ADRL		equ	EP0OUT_ODD+2
EP0OUT_ODD_ADRH		equ	EP0OUT_ODD+3

EP0IN			equ	BDT_START+(BDT_ENTRY_SIZE*2)
EP0IN_STAT		equ	EP0IN+0
EP0IN_CNT		equ	EP0IN+1
EP0IN_ADRL		equ	EP0IN+2
EP0IN_ADRH		equ	EP0IN+3

EP1OUT			equ	BDT_START+(BDT_ENTRY_SIZE*3)
EP1OUT_STAT		equ	EP1OUT+0
EP1OUT_CNT		equ	EP1OUT+1
EP1OUT_ADRL		equ	EP1OUT+2
EP1OUT_ADRH		equ	EP1OUT+3

EP1IN			equ	BDT_START+(BDT_ENTRY_SIZE*4)
EP1IN_STAT		equ	EP1IN+0
EP1IN_CNT		equ	EP1IN+1
EP1IN_ADRL		equ	EP1IN+2
EP1IN_ADRH		equ	EP1IN+3

EP2OUT			equ	BDT_START+(BDT_ENTRY_SIZE*5)
EP2OUT_STAT		equ	EP2OUT+0
EP2OUT_CNT		equ	EP2OUT+1
EP2OUT_ADRL		equ	EP2OUT+2
EP2OUT_ADRH		equ	EP2OUT+3

EP2IN			equ	BDT_START+(BDT_ENTRY_SIZE*6)
EP2IN_STAT		equ	EP2IN+0
EP2IN_CNT		equ	EP2IN+1
EP2IN_ADRL		equ	EP2IN+2
EP2IN_ADRH		equ	EP2IN+3

EP3OUT			equ	BDT_START+(BDT_ENTRY_SIZE*7)
EP3OUT_STAT		equ	EP3OUT+0
EP3OUT_CNT		equ	EP3OUT+1
EP3OUT_ADRL		equ	EP3OUT+2
EP3OUT_ADRH		equ	EP3OUT+3

EP3IN			equ	BDT_START+(BDT_ENTRY_SIZE*8)
EP3IN_STAT		equ	EP3IN+0
EP3IN_CNT		equ	EP3IN+1
EP3IN_ADRL		equ	EP3IN+2
EP3IN_ADRH		equ	EP3IN+3

EP4OUT			equ	BDT_START+(BDT_ENTRY_SIZE*9)
EP4OUT_STAT		equ	EP4OUT+0
EP4OUT_CNT		equ	EP4OUT+1
EP4OUT_ADRL		equ	EP4OUT+2
EP4OUT_ADRH		equ	EP4OUT+3

EP4IN			equ	BDT_START+(BDT_ENTRY_SIZE*10)
EP4IN_STAT		equ	EP4IN+0
EP4IN_CNT		equ	EP4IN+1
EP4IN_ADRL		equ	EP4IN+2
EP4IN_ADRH		equ	EP4IN+3

EP5OUT			equ	BDT_START+(BDT_ENTRY_SIZE*11)
EP5OUT_STAT		equ	EP5OUT+0
EP5OUT_CNT		equ	EP5OUT+1
EP5OUT_ADRL		equ	EP5OUT+2
EP5OUT_ADRH		equ	EP5OUT+3

EP5IN			equ	BDT_START+(BDT_ENTRY_SIZE*12)
EP5IN_STAT		equ	EP5IN+0
EP5IN_CNT		equ	EP5IN+1
EP5IN_ADRL		equ	EP5IN+2
EP5IN_ADRH		equ	EP5IN+3

EP6OUT			equ	BDT_START+(BDT_ENTRY_SIZE*13)
EP6OUT_STAT		equ	EP6OUT+0
EP6OUT_CNT		equ	EP6OUT+1
EP6OUT_ADRL		equ	EP6OUT+2
EP6OUT_ADRH		equ	EP6OUT+3

EP6IN			equ	BDT_START+(BDT_ENTRY_SIZE*14)
EP6IN_STAT		equ	EP6IN+0
EP6IN_CNT		equ	EP6IN+1
EP6IN_ADRL		equ	EP6IN+2
EP6IN_ADRH		equ	EP6IN+3

EP7OUT			equ	BDT_START+(BDT_ENTRY_SIZE*15)
EP7OUT_STAT		equ	EP7OUT+0
EP7OUT_CNT		equ	EP7OUT+1
EP7OUT_ADRL		equ	EP7OUT+2
EP7OUT_ADRH		equ	EP7OUT+3

EP7IN			equ	BDT_START+(BDT_ENTRY_SIZE*16)
EP7IN_STAT		equ	EP7IN+0
EP7IN_CNT		equ	EP7IN+1
EP7IN_ADRL		equ	EP7IN+2
EP7IN_ADRH		equ	EP7IN+3

; First address available for buffers.
; (Microchip warns against using EPT entries for unused endpoints as buffer space.)
BUF_START		equ	0x2044


; Banked addresses, for use with non-indirect operations.

BANKED_BDT_START	equ	0x0020

BANKED_EP0OUT_EVEN	equ	BANKED_BDT_START+(BDT_ENTRY_SIZE*0)
BANKED_EP0OUT_EVEN_STAT	equ	BANKED_EP0OUT_EVEN+0
BANKED_EP0OUT_EVEN_CNT	equ	BANKED_EP0OUT_EVEN+1
BANKED_EP0OUT_EVEN_ADRL	equ	BANKED_EP0OUT_EVEN+2
BANKED_EP0OUT_EVEN_ADRH	equ	BANKED_EP0OUT_EVEN+3

BANKED_EP0OUT_ODD	equ	BANKED_BDT_START+(BDT_ENTRY_SIZE*1)
BANKED_EP0OUT_ODD_STAT	equ	BANKED_EP0OUT_ODD+0
BANKED_EP0OUT_ODD_CNT	equ	BANKED_EP0OUT_ODD+1
BANKED_EP0OUT_ODD_ADRL	equ	BANKED_EP0OUT_ODD+2
BANKED_EP0OUT_ODD_ADRH	equ	BANKED_EP0OUT_ODD+3

BANKED_EP0IN		equ	BANKED_BDT_START+(BDT_ENTRY_SIZE*2)
BANKED_EP0IN_STAT	equ	BANKED_EP0IN+0
BANKED_EP0IN_CNT	equ	BANKED_EP0IN+1
BANKED_EP0IN_ADRL	equ	BANKED_EP0IN+2
BANKED_EP0IN_ADRH	equ	BANKED_EP0IN+3

BANKED_EP1OUT		equ	BANKED_BDT_START+(BDT_ENTRY_SIZE*3)
BANKED_EP1OUT_STAT	equ	BANKED_EP1OUT+0
BANKED_EP1OUT_CNT	equ	BANKED_EP1OUT+1
BANKED_EP1OUT_ADRL	equ	BANKED_EP1OUT+2
BANKED_EP1OUT_ADRH	equ	BANKED_EP1OUT+3

BANKED_EP1IN		equ	BANKED_BDT_START+(BDT_ENTRY_SIZE*4)
BANKED_EP1IN_STAT	equ	BANKED_EP1IN+0
BANKED_EP1IN_CNT	equ	BANKED_EP1IN+1
BANKED_EP1IN_ADRL	equ	BANKED_EP1IN+2
BANKED_EP1IN_ADRH	equ	BANKED_EP1IN+3

BANKED_EP2OUT		equ	BANKED_BDT_START+(BDT_ENTRY_SIZE*5)
BANKED_EP2OUT_STAT	equ	BANKED_EP2OUT+0
BANKED_EP2OUT_CNT	equ	BANKED_EP2OUT+1
BANKED_EP2OUT_ADRL	equ	BANKED_EP2OUT+2
BANKED_EP2OUT_ADRH	equ	BANKED_EP2OUT+3

BANKED_EP2IN		equ	BANKED_BDT_START+(BDT_ENTRY_SIZE*6)
BANKED_EP2IN_STAT	equ	BANKED_EP2IN+0
BANKED_EP2IN_CNT	equ	BANKED_EP2IN+1
BANKED_EP2IN_ADRL	equ	BANKED_EP2IN+2
BANKED_EP2IN_ADRH	equ	BANKED_EP2IN+3

BANKED_EP3OUT		equ	BANKED_BDT_START+(BDT_ENTRY_SIZE*7)
BANKED_EP3OUT_STAT	equ	BANKED_EP3OUT+0
BANKED_EP3OUT_CNT	equ	BANKED_EP3OUT+1
BANKED_EP3OUT_ADRL	equ	BANKED_EP3OUT+2
BANKED_EP3OUT_ADRH	equ	BANKED_EP3OUT+3

BANKED_EP3IN		equ	BANKED_BDT_START+(BDT_ENTRY_SIZE*8)
BANKED_EP3IN_STAT	equ	BANKED_EP3IN+0
BANKED_EP3IN_CNT	equ	BANKED_EP3IN+1
BANKED_EP3IN_ADRL	equ	BANKED_EP3IN+2
BANKED_EP3IN_ADRH	equ	BANKED_EP3IN+3

BANKED_EP4OUT		equ	BANKED_BDT_START+(BDT_ENTRY_SIZE*9)
BANKED_EP4OUT_STAT	equ	BANKED_EP4OUT+0
BANKED_EP4OUT_CNT	equ	BANKED_EP4OUT+1
BANKED_EP4OUT_ADRL	equ	BANKED_EP4OUT+2
BANKED_EP4OUT_ADRH	equ	BANKED_EP4OUT+3

BANKED_EP4IN		equ	BANKED_BDT_START+(BDT_ENTRY_SIZE*10)
BANKED_EP4IN_STAT	equ	BANKED_EP4IN+0
BANKED_EP4IN_CNT	equ	BANKED_EP4IN+1
BANKED_EP4IN_ADRL	equ	BANKED_EP4IN+2
BANKED_EP4IN_ADRH	equ	BANKED_EP4IN+3

BANKED_EP5OUT		equ	BANKED_BDT_START+(BDT_ENTRY_SIZE*11)
BANKED_EP5OUT_STAT	equ	BANKED_EP5OUT+0
BANKED_EP5OUT_CNT	equ	BANKED_EP5OUT+1
BANKED_EP5OUT_ADRL	equ	BANKED_EP5OUT+2
BANKED_EP5OUT_ADRH	equ	BANKED_EP5OUT+3

BANKED_EP5IN		equ	BANKED_BDT_START+(BDT_ENTRY_SIZE*12)
BANKED_EP5IN_STAT	equ	BANKED_EP5IN+0
BANKED_EP5IN_CNT	equ	BANKED_EP5IN+1
BANKED_EP5IN_ADRL	equ	BANKED_EP5IN+2
BANKED_EP5IN_ADRH	equ	BANKED_EP5IN+3

BANKED_EP6OUT		equ	BANKED_BDT_START+(BDT_ENTRY_SIZE*13)
BANKED_EP6OUT_STAT	equ	BANKED_EP6OUT+0
BANKED_EP6OUT_CNT	equ	BANKED_EP6OUT+1
BANKED_EP6OUT_ADRL	equ	BANKED_EP6OUT+2
BANKED_EP6OUT_ADRH	equ	BANKED_EP6OUT+3

BANKED_EP6IN		equ	BANKED_BDT_START+(BDT_ENTRY_SIZE*14)
BANKED_EP6IN_STAT	equ	BANKED_EP6IN+0
BANKED_EP6IN_CNT	equ	BANKED_EP6IN+1
BANKED_EP6IN_ADRL	equ	BANKED_EP6IN+2
BANKED_EP6IN_ADRH	equ	BANKED_EP6IN+3

BANKED_EP7OUT		equ	BANKED_BDT_START+(BDT_ENTRY_SIZE*15)
BANKED_EP7OUT_STAT	equ	BANKED_EP7OUT+0
BANKED_EP7OUT_CNT	equ	BANKED_EP7OUT+1
BANKED_EP7OUT_ADRL	equ	BANKED_EP7OUT+2
BANKED_EP7OUT_ADRH	equ	BANKED_EP7OUT+3

BANKED_EP7IN		equ	BANKED_BDT_START+(BDT_ENTRY_SIZE*16)
BANKED_EP7IN_STAT	equ	BANKED_EP7IN+0
BANKED_EP7IN_CNT	equ	BANKED_EP7IN+1
BANKED_EP7IN_ADRL	equ	BANKED_EP7IN+2
BANKED_EP7IN_ADRH	equ	BANKED_EP7IN+3



; BDnSTAT bit masks
_DAT0		equ	0x00
_DAT1		equ	0x40
_BSTALL		equ	0x04
_USIE		equ	0x80
_UCPU		equ	0x00



; BDnSTAT bit numbers
UOWN		equ	7
DTS		equ	6
DTSEN		equ	3
BSTALL		equ	2
BC9		equ	1
BC8		equ	0

